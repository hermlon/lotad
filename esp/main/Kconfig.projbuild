## esp/main/Kconfig.projbuild
```kconfig
menu "Example Configuration"

	config ESP_MAXIMUM_RETRY
		int "Maximum retry"
		default 5
		help
			Set the Maximum retry to avoid station reconnecting to the AP unlimited when the AP is really inexistent.

	config BYPASS_AUTH
		int "Bypass auth"
		default 0
		help
			Bypass authentication

	config SNTP_TIME_SERVER
        string "SNTP server name"
        default "pool.ntp.org"
        help
            Hostname of the main SNTP server.

endmenu
```
